## products/go/main/Kconfig.projbuild
```kconfig
menu "AirGradient Go"

    config GO_PORTABLE_PROV_RADIO_IDLE_MS
        int "Portable provisioning Wi-Fi radio idle timeout (ms)"
        range 10000 600000
        default 90000
        help
            In Portable mode, attached Wi-Fi provisioning brings the Wi-Fi
            radio up on demand for a scan / connect and drops it again to
            preserve the Portable power profile. This bounds how long the
            radio stays powered after the last scan/credentials request even
            while the app remains connected on the BLE link. The timer is
            armed/re-armed on every request and cancelled when the radio
            drops (on connect verify-then-drop, BLE disconnect, or mode exit).

    config TRACKING_FSYNC_INTERVAL_MS
        int "Tracking fsync interval (ms)"
        range 1000 600000
        default 30000
        help
            Maximum age of unsynced route points before append_route_point()
            forces an fflush + fsync. Bounds worst-case data loss on a
            power cut. Lower = safer; higher = less NAND wear.

    config GO_SNTP_SERVER
        string "Stationary mode SNTP server"
        default "pool.ntp.org"
        help
            NTP server used to set the system clock while the device is
            online in Stationary mode. The clock then carries over to
            Portable mode, so route points recorded before the first GPS fix
            get a real timestamp. Leave empty to disable SNTP.

endmenu
```
